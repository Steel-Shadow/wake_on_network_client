## main/Kconfig.projbuild
```kconfig
menu "WiFi Configuration"

    config WON_WIFI_SSID
        string "WiFi SSID"
        default "replace_with_your_SSID"
        help
            SSID (network name) for the example to connect to.

    choice
        prompt "Enterprise configuration to be used"
        default WON_WPA2_ENTERPRISE
        config WON_WPA2_ENTERPRISE
            bool "WPA2_ENT"
        config WON_WPA3_ENTERPRISE
            bool "WPA3_ENT"
        config WON_WPA3_192BIT_ENTERPRISE
            bool "WPA3_192BIT_ENT"
            depends on SOC_WIFI_GCMP_SUPPORT
            select ESP_WIFI_GCMP_SUPPORT
            select ESP_WIFI_GMAC_SUPPORT
            select ESP_WIFI_SUITE_B_192
    endchoice

    config WON_VALIDATE_SERVER_CERT
        bool "Validate server"
        default n
        help
            Validate the servers' certificate using CA cert.

    choice
        prompt "EAP method for the example to use"
        default WON_EAP_METHOD_PEAP
        config WON_EAP_METHOD_TLS
            bool "TLS"
        config WON_EAP_METHOD_PEAP
            bool "PEAP"
        config WON_EAP_METHOD_TTLS
            bool "TTLS"
    endchoice

    config WON_EAP_METHOD
        int
        default 0 if WON_EAP_METHOD_TLS
        default 1 if WON_EAP_METHOD_PEAP
        default 2 if WON_EAP_METHOD_TTLS

    choice
        prompt "Phase2 method for TTLS"
        depends on WON_EAP_METHOD_TTLS
        default WON_EAP_METHOD_TTLS_PHASE2_MSCHAPV2
        config WON_EAP_METHOD_TTLS_PHASE2_MSCHAPV2
            bool "MSCHAPV2"
        config WON_EAP_METHOD_TTLS_PHASE2_MSCHAP
            bool "MSCHAP"
        config WON_EAP_METHOD_TTLS_PHASE2_PAP
            bool "PAP"
        config WON_EAP_METHOD_TTLS_PHASE2_CHAP
            bool "CHAP"
    endchoice

    config WON_EAP_METHOD_TTLS_PHASE_2
        int
        default 1 if WON_EAP_METHOD_TTLS_PHASE2_MSCHAPV2
        default 2 if WON_EAP_METHOD_TTLS_PHASE2_MSCHAP
        default 3 if WON_EAP_METHOD_TTLS_PHASE2_PAP
        default 4 if WON_EAP_METHOD_TTLS_PHASE2_CHAP

    config WON_EAP_ID
        string "EAP ID"
        default "replace_with_your_ID"
        help
            Identity in phase 1 of EAP procedure.

    config WON_EAP_USERNAME
        string "EAP USERNAME"
        depends on WON_EAP_METHOD_PEAP || WON_EAP_METHOD_TTLS
        default "replace_with_your_username"
        help
            Username for EAP method (valid for PEAP and TTLS).

    config WON_EAP_PASSWORD
        string "EAP PASSWORD"
        depends on WON_EAP_METHOD_PEAP || WON_EAP_METHOD_TTLS
        default "replace_with_your_password"
        help
            Password for EAP method (valid for PEAP and TTLS).

    config WON_USE_DEFAULT_CERT_BUNDLE
        bool "Use default cert bundle"
        depends on WON_VALIDATE_SERVER_CERT
        default y
        help
            Use default CA certificate bundle for WiFi enterprise connection

    config WON_VALIDATE_SERVER_CERT_DOMAIN
        bool "Enable server certificate domain validation"
        depends on WON_VALIDATE_SERVER_CERT
        default n
        help
            Enable validation of the server certificate's domain name.

    config WON_SERVER_CERT_DOMAIN
        string "Expected server certificate domain"
        depends on WON_VALIDATE_SERVER_CERT_DOMAIN
        default "espressif.com"
        help
            Specify the expected domain name for the server certificate.
            The connection will be accepted only if the server certificate matches this domain.
endmenu


menu "Websocket Configuration"

    config WS_OVER_TLS_SERVER_AUTH
        bool "Enable WebSocket over TLS with Server Certificate Verification Only"
        default y
        help
            Enables WebSocket connections over TLS (WSS) with server certificate verification.
            This setting mandates the client to verify the servers certificate, while the server
            does not require client certificate verification.

    config WS_OVER_TLS_MUTUAL_AUTH
        bool "Enable WebSocket over TLS with Server Client Mutual Authentification"
        default n
        help
            Enables WebSocket connections over TLS (WSS) with server and client mutual certificate verification.

    config WS_OVER_TLS_SKIP_COMMON_NAME_CHECK
        bool "Skip common name(CN) check during TLS authentification"
        default n
        help
            Skipping Common Name(CN) check during TLS(WSS) authentificatio

    if CONFIG_IDF_TARGET = "linux"
      config GCOV_ENABLED
          bool "Coverage analyzer"
          default n
          help
              Enables coverage analyzing for host tests.
      endif
endmenu
```
